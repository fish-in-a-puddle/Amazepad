// Copyright 2023 QMK
// SPDX-License-Identifier: GPL-2.0-or-later

#include QMK_KEYBOARD_H

const uint16_t PROGMEM keymaps[][MATRIX_ROWS][MATRIX_COLS] = {
    [0] = LAYOUT(
        KC_MUTE,   ALL,   UNDO,
        KC_COPY,   KC_PASTE, SAVE 
    )
};


enum custom_keycodes {
    SAVE = SAFE_RANGE,
    UNDO,
    ALL,

};

bool process_record_user(uint16_t keycode, keyrecord_t *record) {
    switch (keycode) {
    case SAVE:
        if (record->event.pressed) {
            SEND_STRING(SS_LCTL("s");
        } else {
        }
        break;
    case UNDO:
        if (record->event.pressed) {
            SEND_STRING(SS_LCTL("z");
        } else {
        }
        break;
    case ALL:
        if (record->event.pressed) {
            SEND_STRING(SS_LCTL("a");
        } else {
        }
        break;
    };




};

static void thumbs_up(void) {
    const unsigned char epd_bitmap_bead_pattern__2_ [] PROGMEM = {
	0xff, 0xff, 0xff, 0xff, 0xff, 0xff, 0xff, 0xff, 0xff, 0xff, 0xff, 0xff,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 0x43, 
	0xe2, 0x07, 0x02, 0x18, 0xc7, 0xff, 0xfe, 0xff, 0xc3, 0xff, 0x3f, 0xe4,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 0xff, 
	0x0c, 0x78, 0x5f, 0xfc, 0x3c, 0x3c, 0x70, 0x06, 0x1f, 0xc2, 0x00, 0xc0,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 0x18, 
	0x78, 0x1f, 0x0c, 0x30, 0x41, 0xfe, 0xfe, 0x68, 0x7f, 0x1f, 0xe3, 0xe3,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 0xff, 
	0xff, 0xff, 0xf0, 0x0f, 0x1f, 0xfe, 0x00, 0xc7, 0xe1, 0x00, 0x7f, 0x1f,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 0xff, 
	0xff, 0xff, 0xff, 0xff, 0xfe, 0xff, 0xff, 0xff, 0xff, 0xff, 0xff, 0xff, 0xff, 0xff, 0xff, 0xff, 0xff, 0xff, 0xff, 0xfe
    };
    oled_write_raw_P(raw_logo, sizeof(raw_logo));
};

static void great_encouragement(void) {
    const unsigned char epd_bitmap_bead_pattern__3_ [] PROGMEM = {
	0xff, 0xff, 0xff, 0xff, 0xff, 0xff, 0xff, 0xff, 0xff, 0xff, 0xff, 0xff,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 0xf9, 
	0x91, 0xcf, 0x3f, 0x0f, 0x9f, 0x23, 0xfe, 0xff, 0x76, 0x04, 0xf7, 0xfc,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 0xff, 
	0x03, 0x80, 0x1f, 0xf1, 0xfc, 0xe2, 0x3f, 0xc8, 0xfc, 0xfe, 0x07, 0x11,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 0xff, 
	0xff, 0xff, 0xff, 0xff, 0xff, 0xfe, 0xff, 0xff, 0xff, 0xff, 0xff, 0xff,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 0x9c, 
	0x66, 0x27, 0xc8, 0xe2, 0x47, 0xc0, 0x31, 0x0c, 0xf9, 0xf4, 0x78, 0xc3,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 0xff, 
	0xff, 0xff, 0xff, 0xff, 0xfe, 0xff, 0xff, 0xff, 0xff, 0xff, 0xff, 0xff, 0xff, 0xff, 0xff, 0xff, 0xff, 0xff, 0xff, 0xfe
    };
    oled_write_raw_P(raw_logo, sizeof(raw_logo));
}

static void amaze_amaze(void) {
        const unsigned char epd_bitmap_bead_pattern__1___1_ [] PROGMEM = {
	0xff, 0xff, 0xff, 0xff, 0xff, 0xff, 0xff, 0xff, 0xff, 0xff, 0xff, 0xff, 0xf0, 0xff, 0xff, 0xff, 
	0xff, 0xff, 0xff, 0xff, 0xff, 0xff, 0xff, 0xff, 0xff, 0xf0, 0xff, 0xff, 0xff, 0xff, 0xff, 0xff, 
	0xff, 0xff, 0xff, 0xff, 0xff, 0xff, 0xf0, 0xff, 0xff, 0xff, 0xff, 0xcf, 0x8e, 0x7c, 0xf8, 0x02, 
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	0xff, 0xff, 0xff, 0xf0
};

    oled_write_raw_P(raw_logo, sizeof(raw_logo));
  };

bool encoder_update_user(uint8_t index, bool clockwise) {
    if (index == 0) {               
        if (clockwise) {
            tap_code(KC_VOLU);      
        } else {
            tap_code(KC_VOLD);    
        }
    }

    return false;
}

bool oled_task_user(void) {
    if (get_current_wpm() < 15) {
        great_encouragement();
    }
    else if (get_current_wpm() >= 15 && get_current_wpm() < 30) {
        thumbs_up();
    }
    else {
        amaze_amaze();
    }
    return false;
}
